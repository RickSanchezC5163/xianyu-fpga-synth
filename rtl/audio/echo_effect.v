// Bounded mono delay for the FPGA audio path.  No PCM recording or host stream:
// the RAM holds only the last DEPTH live samples generated by additive_core.
module echo_effect #(
    parameter integer DEPTH=4096,
    parameter integer ADDR_BITS=12
) (
    input wire clk,
    input wire rst_n,
    input wire clear,
    input wire sample_valid,
    input wire signed [23:0] sample_in,
    input wire [6:0] mix,
    input wire [6:0] feedback,
    output reg signed [23:0] sample_out,
    output reg output_valid,
    output reg overrun
);
    reg signed [23:0] delay_ram [0:DEPTH-1];
    reg [ADDR_BITS-1:0] address;
    reg [ADDR_BITS-1:0] write_address;
    reg [ADDR_BITS:0] filled;
    reg signed [23:0] delayed;
    reg signed [23:0] dry;
    reg [6:0] mix_saved,feedback_saved;
    localparam [1:0] IDLE=0,MULTIPLY=1,ADD=2,EMIT=3;
    reg [1:0] phase;
    wire pending=phase!=IDLE;

    reg signed [31:0] wet_product,feedback_product;
    wire signed [31:0] dry_extended={{8{dry[23]}},dry};
    reg signed [31:0] output_sum,write_sum;

    function signed [23:0] saturate24;
        input signed [31:0] value;
        begin
            if(value>32'sd8388607) saturate24=24'sh7fffff;
            else if(value< -32'sd8388608) saturate24=24'sh800000;
            else saturate24=value[23:0];
        end
    endfunction

    always @(posedge clk or negedge rst_n) begin
        if(!rst_n) begin
            address<=0;write_address<=0;filled<=0;delayed<=0;dry<=0;
            mix_saved<=0;feedback_saved<=0;phase<=IDLE;
            wet_product<=0;feedback_product<=0;output_sum<=0;write_sum<=0;
            sample_out<=0;output_valid<=0;overrun<=0;
        end else if(clear) begin
            // Reset only pointers. Old RAM contents cannot be read until a
            // whole fresh delay window has been filled with live samples.
            address<=0;write_address<=0;filled<=0;phase<=IDLE;
            delayed<=0;dry<=0;sample_out<=0;output_valid<=0;overrun<=0;
            wet_product<=0;feedback_product<=0;output_sum<=0;write_sum<=0;
        end else begin
            output_valid<=0;
            // Each arithmetic boundary is registered. In particular, the
            // synchronous RAM read no longer feeds multiply, add, saturation
            // and RAM writeback in one 50 MHz clock period.
            case(phase)
                MULTIPLY:begin
                    wet_product<=delayed*$signed({1'b0,mix_saved});
                    feedback_product<=delayed*$signed({1'b0,feedback_saved});
                    phase<=ADD;
                end
                ADD:begin
                    output_sum<=dry_extended+(wet_product>>>7);
                    write_sum<=dry_extended+(feedback_product>>>7);
                    phase<=EMIT;
                end
                EMIT:begin
                    delay_ram[write_address]<=saturate24(write_sum);
                    sample_out<=saturate24(output_sum);
                    output_valid<=1;
                    phase<=IDLE;
                end
                default:phase<=IDLE;
            endcase
            if(sample_valid) begin
                if(pending) overrun<=1;
                else begin
                    // Synchronous read: delayed receives the prior contents
                    // on this edge. One sample completes three clocks later;
                    // no new sample is accepted until its feedback write lands.
                    delayed<=filled==DEPTH ? delay_ram[address] : 24'sd0;
                    dry<=sample_in;
                    mix_saved<=mix;
                    feedback_saved<=feedback;
                    write_address<=address;
                    address<=address==DEPTH-1 ? {ADDR_BITS{1'b0}} : address+1'b1;
                    if(filled<DEPTH) filled<=filled+1'b1;
                    phase<=MULTIPLY;
                end
            end
        end
    end
endmodule
